
LOCAL &i &a
&i=0x00000000
&a=0x01100110
&i=(&a<<2.)|&a
PRINT "&i"



ENDDO
