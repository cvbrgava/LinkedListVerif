LOCAL &temp 
LOCAL &LinkListAddr
LOCAL &RefLinkAddr
LOCAL &choice
LOCAL &filename
LOCAL &parent_folder

ENTRY &choice &parent_folder
IF &choice==0.
(
	Dialog.view "&parent_folder\GUI\GenDump.dlg"
	STOP
	&LinkListAddr=DIALOG.STRING(ADDR)
	&filename=DIALOG.STRING(FILE)
	GOSUB Traverse &LinkListAddr
	ENTRY &LinkListAddr
	Print "Last link found at : &LinkListAddr "
	GOSUB GenDump &LinkListAddr &parent_folder\data\&filename
	Print "Last link dumped into : &parent_folder\data\&filename"
)
ELSE
(
	Dialog.view "&parent_folder\GUI\Compare.dlg"
	STOP 
	&LinkListAddr=DIALOG.STRING(ADDR)
	&filename=DIALOG.STRING(FILE)
	&RefLinkAddr=DIALOG.STRING(REF)
	GOSUB Traverse &LinkListAddr
	ENTRY &LinkListAddr
	data.load.asciihexb &parent_folder\data\&filename D:&RefLinkAddr
	area.clear
	print "Reference data loaded..."
	area.view
	GOSUB Parser D:&LinkListAddr D:&LinkListAddr+0x1F D:&RefLinkAddr

)

ENDDO


Traverse:
	LOCAL &next_addr &currnt_addr
	ENTRY &currnt_addr
	
	&next_addr=DATA.LONG(D:&currnt_addr+0x1C)
	
	WHILE &next_addr!=0x0
	(
		&currnt_addr=&next_addr
		&next_addr=DATA.LONG(D:&currnt_addr+0x1C)
	)
	
	RETURN &currnt_addr
	
GenDump:
	LOCAL &dump_addr
	ENTRY &dump_addr &file_location
	
	data.save.ahb &file_location D:&dump_addr++0x1F 
	Return
	
	
Parser:
	LOCAL &start &end &ref_start &diff &off &int_start
	ENTRY &start &end &ref_start
	
	
	&int_start=&start
	
	WHILE &int_start!=&end
	(
	&diff=&end-&int_start
	data.compare &int_start++&diff &ref_start
	
	if found()
		(
		print "Diff. found at address " TRACK.ADDRESS()
		&off=TRACK.ADDRESS()-&int_start
		;print &int_start 
		GOSUB FieldPrint TRACK.ADDRESS()-&start &int_start &ref_start
		&ref_start=&ref_start+&off+1.
		&int_start=&int_start+&off+1.
		)
	else 
		return
	)
	
FieldPrint:
	LOCAL &off &init_start &ref_start &temp1 &temp
	ENTRY &off &init_start &ref_start 
	if &off==0.||&off==1.
	(
		print "Mismatch: WORD0 XFER_LEN"
	)
	else if &off==2.
	(
		print "Mismatch: WORD0 IRQ_EN / IRQ_NUM"
	)
	else if &off==3.
	(
		print "Mismatch: WORD0 Start  /  DIR / LMEM Update / MEMP Update"
	)
	else if &off==4.
	(
		print "Mismatch: WORD1 Modulo / Bias"
	)
	else if &off==5.
	(
		print "Mismatch: WORD1 Reserved bits - Ignore"
	)
	else if &off==6.
	(
		print "Mismatch: WORD1 LMEM Format"
	)
	else if &off==7.
	(
		print "Mismatch: WORD1 MEMP Format"
	)
	else if &off==8.||&off==9.
	(
		print "Mismatch: WORD2 VBUF_LEN"
	)
	else if &off==10.||&off==11.
	(
		print "Mismatch: WORD2 LMEM Address - Ignore "
	)
	else if &off==12.||&off==13.
	(
		print "Mismatch: WORD3 MP Address - Ignore"
	)
	else if &off==14.
	(
		print "Mismatch: WORD3 INIT_BANK / MAX_BANK / MIN_BANK"
	)
	else if &off==15.
	(
		print "Mismatch: WORD3 QSIZE / INIT_BANK"
	)
	else if &off==16.||&off==17.
	(
		print "Mismatch: WORD4 START_VADDR"
	)
	else if &off==18.||&off==19.
	(
		print "Mismatch: WORD4 INDEX_0"
	)
	else if &off==20.||&off==21.
	(
		print "Mismatch: WORD5 M16_MODULO"
	)
	else if &off==22.||&off==23.
	(
		print "Mismatch: WORD5 LINE_STRIDE1"
	)
	else if &off==24.||&off==25.
	(
		print "Mismatch: WORD6 STRIDE_S"
	)
	else if &off==26.||&off==27.
	(
		print "Mismatch: WORD6 LMEM METHOD"
	)
	else if &off==28.||&off==29.
	(
		print "Mismatch: WORD7 NULL_POINTER Expected"
	)
	else if &off==30.||&off==31.
	(
		print "Mismatch: WORD7 Reserved - Ignore"
	)
	&temp=&init_start+&off
	&temp=DATA.BYTE(D:&temp)		
	&temp1=&ref_start+&off
	&temp1=DATA.BYTE(D:&temp1)		
	print "EXPECTED: &temp FOUND: &temp1 "
	RETURN
