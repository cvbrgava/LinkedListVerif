LOCAL &temp

&temp="0x"+"A000"

PRINT "&temp"