
LOCAL &read_write_gui 
LOCAL &Start
LOCAL &Dir
LOCAL &LMEM
LOCAL &MEMP
LOCAL &Int
LOCAL &IntNo
LOCAL &NumSmpl
LOCAL &Format_MEMP
LOCAL &Format_LMEM
LOCAL &Format_Mod
LOCAL &Format_Bias
LOCAL &DMA_LMEM
LOCAL &DMA_VBUFLEN
LOCAL &MEMP_Start
LOCAL &MEMP_Index
LOCAL &VBUF_CONF_QSIZE
LOCAL &VBUF_CONF_INIT_BANK
LOCAL &VBUF_CONF_MAX_BANK
LOCAL &VBUF_CONF_MIN_BANK
LOCAL &VBUF_CONF_MP_ADDR
LOCAL &LMEM_CFG0_LINE_STRIDE
LOCAL &LMEM_CFG0_M16_MODULO
LOCAL &LMEM_CFG1_STRIDE_METH
LOCAL &LMEM_CFG1_STRIDE_NBR
LOCAL &POINTER_ADDRESS_HEAD
LOCAL &POINTER_ADDRESS_PREV
LOCAL &POINTER_ADDRESS_NEXT
LOCAL &POINTER_ADDRESS_CRNT
LOCAL &READ_NEXT
LOCAL &READ_PREV
LOCAL &READ_CANCEL
LOCAL &WRITE_NEXT
LOCAL &WRITE_PREV
LOCAL &WRITE_CANCEL
LOCAL &LINKNO
LOCAL &dialog_file
LOCAL &prelim_dialog_file
LOCAL &temp
LOCAL &WORD0 &WORD1 &WORD2 &WORD3 &WORD4 &WORD5 &WORD6 &WORD7
LOCAL &REDRAW
&REDRAW=0.
&prelim_dialog_file="../GUI/ReadWritePrelim.dlg"
&LINKNO=0.
GOSUB Prelim

Prelim:

	DIALOG.VIEW &prelim_dialog_file
	STOP
	&POINTER_ADDRESS_HEAD=DIALOG.STRING(ADDR)
	&temp=DIALOG.BOOLEAN(CHOICE.READ)
	dialog.end

	IF &temp
		(
		GOTO Read
		)
	ELSE 
		(
		GOTO Write
		)



Write:
	if &REDRAW==0.
	(	
		&POINTER_ADDRESS_CRNT=&POINTER_ADDRESS_NEXT
		GOSUB UnsetParams
		
	)
	&REDRAW=0.
	&dialog_file="..\Temp\GUI_Menu.dlg"
	OPEN #1 &dialog_file /create
	WRITE #1 "HEADER ""BDC Modem VI - VPE """
	WRITE #1 ""
	WRITE #1 "POS 1. 1. 60. 30."
	WRITE #1 "BOX ""VPE Linked Lists Verif Suite"""
	WRITE #1 ""
	WRITE #1 "POS 2. 2. 15. 4."
	WRITE #1 "BOX ""START"""
	WRITE #1 "POS 3. 3. 13. 1."
	WRITE #1 "Start.0: CHOOSEBOX ""Wait"" """""
	WRITE #1 "Start.1: CHOOSEBOX ""Start Transfer"" """""
	WRITE #1 ""
	WRITE #1 "POS 18. 2. 15. 4."
	WRITE #1 "BOX ""XFER_DIR"""
	WRITE #1 "POS 19. 3. 13. 1."
	WRITE #1 "Dir.0: CHOOSEBOX ""MEMPOOL to LMEM"" """""
	WRITE #1 "Dir.1: CHOOSEBOX ""LMEM to MEMPOOL"" """""
	WRITE #1 ""
	WRITE #1 "POS 2. 6. 15. 4."
	WRITE #1 "BOX ""LMEM_INDEX_UPDATE"""
	WRITE #1 "POS 3. 7. 13. 1."
	WRITE #1 "LMEM.0: CHOOSEBOX ""No Update"" """""
	WRITE #1 "LMEM.1: CHOOSEBOX ""Update on EOT"" """""
	WRITE #1 ""
	WRITE #1 "POS 18. 6. 15. 4."
	WRITE #1 "BOX ""MP_VADDR_UPDATE"""
	WRITE #1 "POS 19. 7. 13. 1."
	WRITE #1 "MEMP.0: CHOOSEBOX ""No Update"" """""
	WRITE #1 "MEMP.1: CHOOSEBOX ""Update on EOT"" """""
	WRITE #1 ""
	WRITE #1 "POS 2. 10. 15. 4."
	WRITE #1 "BOX ""Interrupt"""
	WRITE #1 "POS 3. 11. 13. 1."
	WRITE #1 "Int.1: CHOOSEBOX ""ENABLE"" """""
	WRITE #1 "Int.0: CHOOSEBOX ""DISABLE"" """""
	WRITE #1 ""
	WRITE #1 "POS 18. 10. 15. 8."
	WRITE #1 "BOX ""Interrupt No"""
	WRITE #1 "POS 19. 12. 3. 1."
	WRITE #1 "IntNo.0: CHOOSEBOX ""0"" """""
	WRITE #1 "IntNo.1: CHOOSEBOX ""1"" """""
	WRITE #1 "IntNo.2: CHOOSEBOX ""2"" """""
	WRITE #1 "IntNo.3: CHOOSEBOX ""3"" """""
	WRITE #1 "POS 25. 12. 3. 1."
	WRITE #1 "IntNo.4: CHOOSEBOX ""4"" """""
	WRITE #1 "IntNo.5: CHOOSEBOX ""5"" """""
	WRITE #1 "IntNo.6: CHOOSEBOX ""6"" """""
	WRITE #1 "IntNo.7: CHOOSEBOX ""7"" """""
	WRITE #1 ""
	WRITE #1 "POS 2. 14. 15. 4."
	WRITE #1 "BOX ""XFER_LEN"""
	WRITE #1 "POS 3. 15. 13. 1."
	WRITE #1 "TEXT ""Number of Samples"""
	WRITE #1 "NumSmpl:EDIT ""&NumSmpl"" """""
	WRITE #1 ""
	WRITE #1 "POS 2. 18. 31. 6."
	WRITE #1 "BOX ""FORMAT"""
	WRITE #1 "POS 3. 19. 13. 1."
	WRITE #1 "TEXT ""MEMP {0..15}"""
	WRITE #1 "Format.MEMP:EDIT ""&Format_MEMP"" """""
	WRITE #1 "POS 3. 21. 13. 1."
	WRITE #1 "TEXT ""LMEM {0...7}"""
	WRITE #1 "Format.LMEM:EDIT ""&Format_LMEM"" """""
	WRITE #1 "POS 17. 19. 15. 1."
	WRITE #1 "TEXT ""MODULATION{0...3}"""
	WRITE #1 "Format.Mod:EDIT ""&Format_Mod"" """""
	WRITE #1 "POS 17. 21. 13. 1."
	WRITE #1 "TEXT ""BIAS"""
	WRITE #1 "Format.Bias:EDIT ""&Format_Bias"" """""
	WRITE #1 ""
	WRITE #1 "POS 2. 24. 15. 6."
	WRITE #1 "BOX ""DMA_ADDR"""
	WRITE #1 "POS 4. 25. 10. 1."
	WRITE #1 "TEXT ""LMEM_ADDR"""
	WRITE #1 "DMA.LMEM:EDIT ""&DMA_LMEM"" """""
	WRITE #1 "POS 4. 27. 10. 1."
	WRITE #1 "TEXT ""VBUF_LEN"""
	WRITE #1 "DMA.VBUFLEN:EDIT ""&DMA_VBUFLEN"" """""
	WRITE #1 ""
	WRITE #1 "POS 18. 24. 15. 6."
	WRITE #1 "BOX ""MEMP_ADDR"""
	WRITE #1 "POS 20. 25. 10. 1."
	WRITE #1 "TEXT ""START_VADDR"""
	WRITE #1 "MEMP.Start:EDIT ""&MEMP_Start"" """""
	WRITE #1 "POS 20. 27. 10. 1."
	WRITE #1 "TEXT ""INDEX_0"""
	WRITE #1 "MEMP.Index:EDIT ""&MEMP_Index"" """""
	WRITE #1 ""
	WRITE #1 "POS 35. 2. 24. 7."
	WRITE #1 "BOX ""VBUF_CONF"""
	WRITE #1 "POS 36. 3. 10. 1."
	WRITE #1 "TEXT ""Q_SIZE"""
	WRITE #1 "POS 47. 3. 10. 1."
	WRITE #1 "VBUF_CONF.QSIZE:EDIT ""&VBUF_CONF_QSIZE"" """""
	WRITE #1 "POS 36. 4. 10. 1."
	WRITE #1 "TEXT ""INIT_BANK"""
	WRITE #1 "POS 47. 4. 10. 1."
	WRITE #1 "VBUF_CONF.INIT_BANK:EDIT ""&VBUF_CONF_INIT_BANK"" """""
	WRITE #1 "POS 36. 5. 10. 1."
	WRITE #1 "TEXT ""MAX_BANK"""
	WRITE #1 "POS 47. 5. 10. 1."
	WRITE #1 "VBUF_CONF.MAX_BANK:EDIT ""&VBUF_CONF_MAX_BANK"" """""
	WRITE #1 "POS 36. 6. 10. 1."
	WRITE #1 "TEXT ""MIN_BANK"""
	WRITE #1 "POS 47. 6. 10. 1."
	WRITE #1 "VBUF_CONF.MIN_BANK:EDIT ""&VBUF_CONF_MIN_BANK"" """""
	WRITE #1 "POS 36. 7. 10. 1."
	WRITE #1 "TEXT ""MP_ADDR"""
	WRITE #1 "POS 47. 7. 10. 1."
	WRITE #1 "VBUF_CONF.MP_ADDR:EDIT ""&VBUF_CONF_MP_ADDR"" """""
	WRITE #1 ""
	WRITE #1 "POS 35. 9. 24. 4."
	WRITE #1 "BOX ""LMEM_CFG0"""
	WRITE #1 "POS 36. 10. 10. 1."
	WRITE #1 "TEXT ""LINE_STRIDE"""
	WRITE #1 "POS 47. 10. 10. 1."
	WRITE #1 "LMEM_CFG0.LINE_STRIDE:EDIT ""&LMEM_CFG0_LINE_STRIDE"" """""
	WRITE #1 "POS 36. 11. 10. 1."
	WRITE #1 "TEXT ""M16_MODULO"""
	WRITE #1 "POS 47. 11. 10. 1."
	WRITE #1 "LMEM_CFG0.M16_MODULO:EDIT ""&LMEM_CFG0_M16_MODULO"" """""
	WRITE #1 ""
	WRITE #1 ""
	WRITE #1 "POS 35. 13. 24. 4."
	WRITE #1 "BOX ""LMEM_CFG1"""
	WRITE #1 "POS 36. 14. 10. 1."
	WRITE #1 "TEXT ""STRIDE_METH"""
	WRITE #1 "POS 47. 14. 10. 1."
	WRITE #1 "LMEM_CFG1.STRIDE_METH:EDIT ""&LMEM_CFG1_STRIDE_METH"" """""
	WRITE #1 "POS 36. 15. 10. 1."
	WRITE #1 "TEXT ""STRIDE_NBR"""
	WRITE #1 "POS 47. 15. 10. 1."
	WRITE #1 "LMEM_CFG1.STRIDE_NBR:EDIT ""&LMEM_CFG1_STRIDE_NBR"" """""
	WRITE #1 ""
	WRITE #1 ""
	WRITE #1 "POS 35. 17. 24. 6."
	WRITE #1 "BOX ""POINTER-ADDRESS"""
	WRITE #1 "POS 36. 18. 10. 1."
	WRITE #1 "TEXT ""HEAD LINK"""
	WRITE #1 "POS 47. 18. 10. 1."
	WRITE #1 "POINTER_ADDRESS.HEAD:EDIT ""&POINTER_ADDRESS_HEAD"" """""
	WRITE #1 "POS 36. 19. 10. 1."
	WRITE #1 "TEXT ""PREV LINK"""
	WRITE #1 "POS 47. 19. 10. 1."
	WRITE #1 "POINTER_ADDRESS.PREV:EDIT ""&POINTER_ADDRESS_PREV"" """""
	WRITE #1 "POS 36. 20. 10. 1."
	WRITE #1 "TEXT ""NEXT LINK"""
	WRITE #1 "POS 47. 20. 10. 1."
	WRITE #1 "POINTER_ADDRESS.NEXT:EDIT ""&POINTER_ADDRESS_NEXT"" """""
	WRITE #1 "POS 36. 21. 10. 1."
	WRITE #1 "TEXT ""CRNT LINK"""
	WRITE #1 "POS 47. 21. 10. 1."
	WRITE #1 "POINTER_ADDRESS.CRNT:EDIT ""&POINTER_ADDRESS_CRNT"" """""
	WRITE #1 ""
	WRITE #1 "POS 36. 23. 24. 1."
	WRITE #1 "TEXT ""Note: All values in Hex only"""
	WRITE #1 ""
	WRITE #1 "POS 35. 24. 12. 5."
	WRITE #1 "READBOX:BOX ""READ"""
	WRITE #1 "POS 36. 25. 10. 1."
	WRITE #1 "READ.NEXT:BUTTON ""NEXT"" """""
	WRITE #1 "POS 36. 26. 10. 1."
	WRITE #1 "READ.PREV:BUTTON ""PREV"" """""
	WRITE #1 "POS 36. 27. 10. 1."
	WRITE #1 "READ.CANCEL:BUTTON ""CANCEL"" ""Dialog.end"""
	WRITE #1 ""
	WRITE #1 "POS 47. 24. 12. 5."
	WRITE #1 "WRITEBOX:BOX ""WRITE"""
	WRITE #1 "POS 48. 25. 10. 1."
	WRITE #1 "WRITE.NEXT:BUTTON ""NEXT"" ""GOTO NextWrite"""
	WRITE #1 "POS 48. 26. 10. 1."
	WRITE #1 "WRITE.PREV:BUTTON ""PREV"" """""
	WRITE #1 "POS 48. 27. 10. 1."
	WRITE #1 "WRITE.CANCEL:BUTTON ""CANCEL"" ""Dialog.end"""
	WRITE #1 ""
	WRITE #1 "POS 35. 29. 25."
	WRITE #1 "TEXT ""go/BDCmodemVI for documentation"""
	CLOSE #1
	

	dialog.view &dialog_file

	IF &LINKNO==0
	(
	DIALOG.SET POINTER_ADDRESS.CRNT FORMAT.HEX(8,&POINTER_ADDRESS_HEAD)
	)
	;DIALOG.SET POINTER_ADDRESS.CRNT FORMAT.HEX(8,43c0000)
;	DIALOG.DISABLE POINTER_ADDRESS.CRNT
;	DIALOG.DISABLE POINTER_ADDRESS.HEAD
;	DIALOG.DISABLE POINTER_ADDRESS.PREV
	
	DIALOG.DISABLE READ.NEXT 
	DIALOG.DISABLE READ.CANCEL 
	DIALOG.DISABLE READ.PREV
	STOP
	
UnsetParams:
	
	&NumSmpl=""
	&Format_MEMP=""
	&Format_LMEM=""
	&Format_Mod=""
	&Format_Bias=""
	&DMA_LMEM=""
	&DMA_VBUFLEN=""
	&MEMP_Start=""
	&MEMP_Index=""
	&VBUF_CONF_QSIZE=""
	&VBUF_CONF_INIT_BANK=""
	&VBUF_CONF_MAX_BANK=""
	&VBUF_CONF_MIN_BANK=""
	&VBUF_CONF_MP_ADDR=""
	&LMEM_CFG0_LINE_STRIDE=""
	&LMEM_CFG0_M16_MODULO=""
	&LMEM_CFG1_STRIDE_METH=""
	&LMEM_CFG1_STRIDE_NBR=""
	&POINTER_ADDRESS_PREV=""
	&POINTER_ADDRESS_NEXT=""	
	Return
	
	
	
	
	
NextWrite:
	
	
	&POINTER_ADDRESS_CRNT=DIALOG.STRING(POINTER_ADDRESS.NEXT)
	GOSUB SetParams
	Dialog.end
	if &REDRAW==0.
	(	
		&LINKNO=&LINKNO+1.
		PRINT "Link No: &LINKNO"
		PRINT "Validity of Values confirmed .... "
		PRINT "Generating words..."
		GOSUB WordGen
		PRINT "Writing to Memory"
		;GOSUB MemWrite
		PRINT "Done!!!"
		&ERROR=0.
	)
	ELSE
	(
		&ERROR=1.
		PRINT "&REDRAW Invalid fields found...."
		PRINT "FIx them before writing to Memory"
	)
	
	IF &POINTER_ADDRESS_NEXT!=0.
	(
		GOTO Write
	)
	ELSE IF &POINTER_ADDRESS_NEXT==0x0
	(
		Print "Last Link Detected"
		GOTO Prelim
	)
	
	
SetParams:
	IF DIALOG.BOOLEAN(Start.0)
	(
		&Start=0x0
	)
	ELSE IF DIALOG.BOOLEAN(Start.1)
	(
		&Start=0x1
	)
	ELSE 
	(
		PRINT "Invalid Entry : START"
		&REDRAW=&REDRAW+1.
	)
	
	IF DIALOG.BOOLEAN(Dir.0)
	(
		&Dir=0x0
		PRINT "&Dir"
	)
	ELSE IF DIALOG.BOOLEAN(Dir.1)
	(
		&Dir=0x1
	)
	ELSE 
	(
		PRINT "Invalid Entry : XFER_DIR"
		&REDRAW=&REDRAW+1.
	)
	
	IF DIALOG.BOOLEAN(LMEM.0)
	(
		&LMEM=0x0
	)
	ELSE IF DIALOG.BOOLEAN(LMEM.1)
	(
		&LMEM=0x1
	)
	ELSE 
	(
		PRINT "Invalid Entry : LMEM_INDEX_UPDATE"
		&REDRAW=&REDRAW+1.
	)
	
	IF DIALOG.BOOLEAN(MEMP.0)
	(
		&MEMP=0x0
	)
	ELSE IF DIALOG.BOOLEAN(MEMP.1)
	(
		&MEMP=0x1
	)
	ELSE 
	(
		PRINT "Invalid Entry : MEMP_VADDR_UPDATE"
		&REDRAW=&REDRAW+1.
	)
	
	IF DIALOG.BOOLEAN(Int.0)
	(
		&Int=0x0
	)
	ELSE IF DIALOG.BOOLEAN(Int.1)
	(
		&Int=0x1
	)
	ELSE 
	(
		PRINT "Invalid Entry : Int"
		&REDRAW=&REDRAW+1.
	)
	
	IF DIALOG.BOOLEAN(IntNo.0)
	(
		&IntNo=0x0
	)
	ELSE IF DIALOG.BOOLEAN(IntNo.1)
	(
		&IntNo=0x1
	)
	ELSE IF DIALOG.BOOLEAN(IntNo.2)
	(
		&IntNo=0x2
	)
	ELSE IF DIALOG.BOOLEAN(IntNo.3)
	(
		&IntNo=0x3
	)
	ELSE IF DIALOG.BOOLEAN(IntNo.4)
	(
		&IntNo=0x4
	)
	ELSE IF DIALOG.BOOLEAN(IntNo.5)
	(
		&IntNo=0x5
	)
	ELSE IF DIALOG.BOOLEAN(IntNo.6)
	(
		&IntNo=0x6
	)
	ELSE IF DIALOG.BOOLEAN(IntNo.7)
	(
		&IntNo=0x7
	)
	ELSE 
	(
		PRINT "Invalid Entry : IntNo"
		&REDRAW=&REDRAW+1.
	)
	
	GOSUB DialogRead NumSmpl
	ENTRY &NumSmpl
	
	GOSUB DialogRead Format.MEMP
	ENTRY &Format_MEMP
	
	GOSUB DialogRead  Format.LMEM
	ENTRY &Format_LMEM
	
	GOSUB DialogRead  Format.Mod
	ENTRY &Format_Mod
	
	GOSUB DialogRead  Format.Bias
	ENTRY &Format_Bias
	
	GOSUB DialogRead  DMA.LMEM
	ENTRY &DMA_LMEM
	
	GOSUB DialogRead  DMA.VBUFLEN
	ENTRY &DMA_VBUFLEN
	
	GOSUB DialogRead  MEMP.Start
	ENTRY &MEMP_Start
	
	GOSUB DialogRead  MEMP.Index
	ENTRY &MEMP_Index
	
	GOSUB DialogRead  VBUF_CONF.QSIZE
	ENTRY &VBUF_CONF_QSIZE
	
	GOSUB DialogRead  VBUF_CONF.INIT_BANK
	ENTRY &VBUF_CONF_INIT_BANK
	
	GOSUB DialogRead  VBUF_CONF.MAX_BANK
	ENTRY &VBUF_CONF_MAX_BANK
	
	GOSUB DialogRead  VBUF_CONF.MIN_BANK
	ENTRY &VBUF_CONF_MIN_BANK
	
	GOSUB DialogRead  VBUF_CONF.MP_ADDR
	ENTRY &VBUF_CONF_MP_ADDR
	
	GOSUB DialogRead  LMEM_CFG0.LINE_STRIDE
	ENTRY &LMEM_CFG0_LINE_STRIDE
	
	GOSUB DialogRead  LMEM_CFG0.M16_MODULO
	ENTRY &LMEM_CFG0_M16_MODULO
	
	GOSUB DialogRead  LMEM_CFG1.STRIDE_METH
	ENTRY &LMEM_CFG1_STRIDE_METH
	
	GOSUB DialogRead  LMEM_CFG1.STRIDE_NBR
	ENTRY &LMEM_CFG1_STRIDE_NBR
	
	GOSUB DialogRead  POINTER_ADDRESS.HEAD
	ENTRY &POINTER_ADDRESS_HEAD
	
	GOSUB DialogRead  POINTER_ADDRESS.PREV
	ENTRY &POINTER_ADDRESS_PREV
	
	GOSUB DialogRead  POINTER_ADDRESS.NEXT
	ENTRY &POINTER_ADDRESS_NEXT
	
	GOSUB DialogRead  POINTER_ADDRESS.CRNT
	ENTRY &POINTER_ADDRESS_CRNT
	
	;&Start_0=DATA.LONG(D:&POINTER_ADDRESS_HEAD)
	;PRINT &Start_0
	RETURN
	
DialogRead:
	LOCAL &DIALOG_VAR &DIALOG_ENTRY &temp
	ENTRY &DIALOG_ENTRY

	&temp=DIALOG.STRING(&DIALOG_ENTRY)
		
	IF "&temp"==""
	(
		&REDRAW=&REDRAW+1.
		PRINT "Invalid Entry : &DIALOG_ENTRY"
	)
	ELSE 
	(
		&temp=FORMAT.HEX(8,&temp)	
	)
	RETURN &temp
	
WordGen:
	&WORD0=0x0
	&WORD0=&WORD0|&Start<<31.|&Dir<<30.|&LMEM<<29.|&MEMP<<28.|&Int<<20.|&IntNo<<16.|&NumSmpl
	
	&WORD1=0x0
	&WORD1=&WORD1|&Format_MEMP<<24.|&Format_LMEM<<16.|&Format_Mod<<5.|&Format_Bias<<0.
	
	&WORD2=0x0
	&WORD2=&WORD2|&DMA_LMEM<<18.|&DMA_VBUFLEN
	
	&WORD3=0x0
	&WORD3=&WORD3|&VBUF_CONF_QSIZE<<28.|&VBUF_CONF_INIT_BANK<<24.|&VBUF_CONF_MAX_BANK<<20.|&VBUF_CONF_MIN_BANK<<16.|&VBUF_CONF_MP_ADDR
	
	&WORD4=0x0
	&WORD4=&WORD4|&MEMP_Index<<18.|&MEMP_Start<<0.
	
	&WORD5=0x0
	&WORD5=&WORD5|&LMEM_CFG0_LINE_STRIDE<<16.|&LMEM_CFG0_M16_MODULO<<0.
	
	&WORD6=0x0
	&WORD6=&WORD6|&LMEM_CFG1_STRIDE_METH<<16.|&LMEM_CFG1_STRIDE_NBR<<0.
	
	&WORD7=0x0
	&WORD7=&WORD7|&POINTER_ADDRESS_NEXT
	
	RETURN
	
	
MemWrite:
	DATA.SET D:&POINTER_ADDRESS_CRNT %LE %LONG &WORD0
	DATA.SET D:&POINTER_ADDRESS_CRNT+0x4 %LE %LONG &WORD1
	DATA.SET D:&POINTER_ADDRESS_CRNT+0x8 %LE %LONG &WORD2
	DATA.SET D:&POINTER_ADDRESS_CRNT+0xC %LE %LONG &WORD3
	DATA.SET D:&POINTER_ADDRESS_CRNT+0x10 %LE %LONG &WORD4
	DATA.SET D:&POINTER_ADDRESS_CRNT+0x14 %LE %LONG &WORD5
	DATA.SET D:&POINTER_ADDRESS_CRNT+0x18 %LE %LONG &WORD6
	DATA.SET D:&POINTER_ADDRESS_CRNT+0x1C %LE %LONG &WORD7
	RETURN