
LOCAL &read_write_gui 
LOCAL &Start_0
LOCAL &Start_1
LOCAL &Dir_0
LOCAL &Dir_1
LOCAL &LMEM_0
LOCAL &LMEM_1
LOCAL &MEMP_0
LOCAL &MEMP_1
LOCAL &Int_1
LOCAL &Int_0
LOCAL &IntNo_0
LOCAL &IntNo_1
LOCAL &IntNo_2
LOCAL &IntNo_3
LOCAL &IntNo_4
LOCAL &IntNo_5
LOCAL &IntNo_6
LOCAL &IntNo_7
LOCAL &NumSmpl
LOCAL &Format_MEMP
LOCAL &Format_LMEM
LOCAL &Format_Mod
LOCAL &Format_Bias
LOCAL &DMA_LMEM
LOCAL &DMA_VBUFLEN
LOCAL &MEMP_Start
LOCAL &MEMP_Index
LOCAL &VBUF_CONF_QSIZE
LOCAL &VBUF_CONF_INIT_BANK
LOCAL &VBUF_CONF_MAX_BANK
LOCAL &VBUF_CONF_MIN_BANK
LOCAL &VBUF_CONF_MP_ADDR
LOCAL &LMEM_CFG0_LINE_STRIDE
LOCAL &LMEM_CFG0_M16_MODULO
LOCAL &LMEM_CFG1_STRIDE_METH
LOCAL &LMEM_CFG1_STRIDE_NBR
LOCAL &POINTER_ADDRESS_HEAD
LOCAL &POINTER_ADDRESS_PREV
LOCAL &POINTER_ADDRESS_NEXT
LOCAL &POINTER_ADDRESS_CRNT
LOCAL &READBOX
LOCAL &READ_NEXT
LOCAL &READ_PREV
LOCAL &READ_CANCEL
LOCAL &WRITEBOX
LOCAL &WRITE_NEXT
LOCAL &WRITE_PREV
LOCAL &WRITE_CANCEL
LOCAL &dialog_file
LOCAL &prelim_dialog_file
LOCAL &temp
&prelim_dialog_file="../GUI/ReadWritePrelim.dlg"

DIALOG.VIEW &prelim_dialog_file
STOP
&POINTER_ADDRESS_HEAD=DIALOG.STRING(ADDR)
&temp=DIALOG.BOOLEAN(CHOICE.READ)
dialog.end


IF &temp
	(
	GOTO Read
	)
ELSE 
	(
	GOTO Write
	)



Write:
	
	&dialog_file="..\Temp\GUI_Menu.dlg"
	OPEN #1 &dialog_file /create
	WRITE #1 "HEADER ""BDC Modem VI - VPE """
	WRITE #1 ""
	WRITE #1 "POS 1. 1. 60. 30."
	WRITE #1 "BOX ""VPE Linked Lists Verif Suite"""
	WRITE #1 ""
	WRITE #1 "POS 2. 2. 15. 4."
	WRITE #1 "BOX ""START"""
	WRITE #1 "POS 3. 3. 13. 1."
	WRITE #1 "Start.0: CHOOSEBOX ""Wait"" """""
	WRITE #1 "Start.1: CHOOSEBOX ""Start Transfer"" """""
	WRITE #1 ""
	WRITE #1 "POS 18. 2. 15. 4."
	WRITE #1 "BOX ""XFER_DIR"""
	WRITE #1 "POS 19. 3. 13. 1."
	WRITE #1 "Dir.0: CHOOSEBOX ""MEMPOOL to LMEM"" """""
	WRITE #1 "Dir.1: CHOOSEBOX ""LMEM to MEMPOOL"" """""
	WRITE #1 ""
	WRITE #1 "POS 2. 6. 15. 4."
	WRITE #1 "BOX ""LMEM_INDEX_UPDATE"""
	WRITE #1 "POS 3. 7. 13. 1."
	WRITE #1 "LMEM.0: CHOOSEBOX ""No Update"" """""
	WRITE #1 "LMEM.1: CHOOSEBOX ""Update on EOT"" """""
	WRITE #1 ""
	WRITE #1 "POS 18. 6. 15. 4."
	WRITE #1 "BOX ""MP_VADDR_UPDATE"""
	WRITE #1 "POS 19. 7. 13. 1."
	WRITE #1 "MEMP.0: CHOOSEBOX ""No Update"" """""
	WRITE #1 "MEMP.1: CHOOSEBOX ""Update on EOT"" """""
	WRITE #1 ""
	WRITE #1 "POS 2. 10. 15. 4."
	WRITE #1 "BOX ""Interrupt"""
	WRITE #1 "POS 3. 11. 13. 1."
	WRITE #1 "Int.1: CHOOSEBOX ""ENABLE"" """""
	WRITE #1 "Int.0: CHOOSEBOX ""DISABLE"" """""
	WRITE #1 ""
	WRITE #1 "POS 18. 10. 15. 8."
	WRITE #1 "BOX ""Interrupt No"""
	WRITE #1 "POS 19. 12. 3. 1."
	WRITE #1 "IntNo.0: CHOOSEBOX ""0"" """""
	WRITE #1 "IntNo.1: CHOOSEBOX ""1"" """""
	WRITE #1 "IntNo.2: CHOOSEBOX ""2"" """""
	WRITE #1 "IntNo.3: CHOOSEBOX ""3"" """""
	WRITE #1 "POS 25. 12. 3. 1."
	WRITE #1 "IntNo.4: CHOOSEBOX ""4"" """""
	WRITE #1 "IntNo.5: CHOOSEBOX ""5"" """""
	WRITE #1 "IntNo.6: CHOOSEBOX ""6"" """""
	WRITE #1 "IntNo.7: CHOOSEBOX ""7"" """""
	WRITE #1 ""
	WRITE #1 "POS 2. 14. 15. 4."
	WRITE #1 "BOX ""XFER_LEN"""
	WRITE #1 "POS 3. 15. 13. 1."
	WRITE #1 "TEXT ""Number of Samples"""
	WRITE #1 "NumSmpl:EDIT """" """""
	WRITE #1 ""
	WRITE #1 "POS 2. 18. 31. 6."
	WRITE #1 "BOX ""FORMAT"""
	WRITE #1 "POS 3. 19. 13. 1."
	WRITE #1 "TEXT ""MEMP {0..15}"""
	WRITE #1 "Format.MEMP:EDIT """" """""
	WRITE #1 "POS 3. 21. 13. 1."
	WRITE #1 "TEXT ""LMEM {0...7}"""
	WRITE #1 "Format.LMEM:EDIT """" """""
	WRITE #1 "POS 17. 19. 15. 1."
	WRITE #1 "TEXT ""MODULATION{0...3}"""
	WRITE #1 "Format.Mod:EDIT """" """""
	WRITE #1 "POS 17. 21. 13. 1."
	WRITE #1 "TEXT ""BIAS"""
	WRITE #1 "Format.Bias:EDIT """" """""
	WRITE #1 ""
	WRITE #1 "POS 2. 24. 15. 6."
	WRITE #1 "BOX ""DMA_ADDR"""
	WRITE #1 "POS 4. 25. 10. 1."
	WRITE #1 "TEXT ""LMEM_ADDR"""
	WRITE #1 "DMA.LMEM:EDIT """" """""
	WRITE #1 "POS 4. 27. 10. 1."
	WRITE #1 "TEXT ""VBUF_LEN"""
	WRITE #1 "DMA.VBUFLEN:EDIT """" """""
	WRITE #1 ""
	WRITE #1 "POS 18. 24. 15. 6."
	WRITE #1 "BOX ""MEMP_ADDR"""
	WRITE #1 "POS 20. 25. 10. 1."
	WRITE #1 "TEXT ""START_VADDR"""
	WRITE #1 "MEMP.Start:EDIT """" """""
	WRITE #1 "POS 20. 27. 10. 1."
	WRITE #1 "TEXT ""INDEX_0"""
	WRITE #1 "MEMP.Index:EDIT """" """""
	WRITE #1 ""
	WRITE #1 "POS 35. 2. 24. 7."
	WRITE #1 "BOX ""VBUF_CONF"""
	WRITE #1 "POS 36. 3. 10. 1."
	WRITE #1 "TEXT ""Q_SIZE"""
	WRITE #1 "POS 47. 3. 10. 1."
	WRITE #1 "VBUF_CONF.QSIZE:EDIT """" """""
	WRITE #1 "POS 36. 4. 10. 1."
	WRITE #1 "TEXT ""INIT_BANK"""
	WRITE #1 "POS 47. 4. 10. 1."
	WRITE #1 "VBUF_CONF.INIT_BANK:EDIT """" """""
	WRITE #1 "POS 36. 5. 10. 1."
	WRITE #1 "TEXT ""MAX_BANK"""
	WRITE #1 "POS 47. 5. 10. 1."
	WRITE #1 "VBUF_CONF.MAX_BANK:EDIT """" """""
	WRITE #1 "POS 36. 6. 10. 1."
	WRITE #1 "TEXT ""MIN_BANK"""
	WRITE #1 "POS 47. 6. 10. 1."
	WRITE #1 "VBUF_CONF.MIN_BANK:EDIT """" """""
	WRITE #1 "POS 36. 7. 10. 1."
	WRITE #1 "TEXT ""MP_ADDR"""
	WRITE #1 "POS 47. 7. 10. 1."
	WRITE #1 "VBUF_CONF.MP_ADDR:EDIT """" """""
	WRITE #1 ""
	WRITE #1 "POS 35. 9. 24. 4."
	WRITE #1 "BOX ""LMEM_CFG0"""
	WRITE #1 "POS 36. 10. 10. 1."
	WRITE #1 "TEXT ""LINE_STRIDE"""
	WRITE #1 "POS 47. 10. 10. 1."
	WRITE #1 "LMEM_CFG0.LINE_STRIDE:EDIT """" """""
	WRITE #1 "POS 36. 11. 10. 1."
	WRITE #1 "TEXT ""M16_MODULO"""
	WRITE #1 "POS 47. 11. 10. 1."
	WRITE #1 "LMEM_CFG0.M16_MODULO:EDIT """" """""
	WRITE #1 ""
	WRITE #1 ""
	WRITE #1 "POS 35. 13. 24. 4."
	WRITE #1 "BOX ""LMEM_CFG1"""
	WRITE #1 "POS 36. 14. 10. 1."
	WRITE #1 "TEXT ""STRIDE_METH"""
	WRITE #1 "POS 47. 14. 10. 1."
	WRITE #1 "LMEM_CFG1.STRIDE_METH:EDIT """" """""
	WRITE #1 "POS 36. 15. 10. 1."
	WRITE #1 "TEXT ""STRIDE_NBR"""
	WRITE #1 "POS 47. 15. 10. 1."
	WRITE #1 "LMEM_CFG1.STRIDE_NBR:EDIT """" """""
	WRITE #1 ""
	WRITE #1 ""
	WRITE #1 "POS 35. 17. 24. 6."
	WRITE #1 "BOX ""POINTER-ADDRESS"""
	WRITE #1 "POS 36. 18. 10. 1."
	WRITE #1 "TEXT ""HEAD LINK"""
	WRITE #1 "POS 47. 18. 10. 1."
	WRITE #1 "POINTER_ADDRESS.HEAD:EDIT ""&POINTER_ADDRESS_HEAD"" """""
	WRITE #1 "POS 36. 19. 10. 1."
	WRITE #1 "TEXT ""PREV LINK"""
	WRITE #1 "POS 47. 19. 10. 1."
	WRITE #1 "POINTER_ADDRESS.PREV:EDIT """" """""
	WRITE #1 "POS 36. 20. 10. 1."
	WRITE #1 "TEXT ""NEXT LINK"""
	WRITE #1 "POS 47. 20. 10. 1."
	WRITE #1 "POINTER_ADDRESS.NEXT:EDIT """" """""
	WRITE #1 "POS 36. 21. 10. 1."
	WRITE #1 "TEXT ""CRNT LINK"""
	WRITE #1 "POS 47. 21. 10. 1."
	WRITE #1 "POINTER_ADDRESS.CRNT:EDIT ""&POINTER_ADDRESS_CRNT"" """""
	WRITE #1 ""
	WRITE #1 "POS 36. 23. 24. 1."
	WRITE #1 "TEXT ""Note: All values in Hex only"""
	WRITE #1 ""
	WRITE #1 "POS 35. 24. 12. 5."
	WRITE #1 "READBOX:BOX ""READ"""
	WRITE #1 "POS 36. 25. 10. 1."
	WRITE #1 "READ.NEXT:BUTTON ""NEXT"" """""
	WRITE #1 "POS 36. 26. 10. 1."
	WRITE #1 "READ.PREV:BUTTON ""PREV"" """""
	WRITE #1 "POS 36. 27. 10. 1."
	WRITE #1 "READ.CANCEL:BUTTON ""CANCEL"" """""
	WRITE #1 ""
	WRITE #1 "POS 47. 24. 12. 5."
	WRITE #1 "WRITEBOX:BOX ""WRITE"""
	WRITE #1 "POS 48. 25. 10. 1."
	WRITE #1 "WRITE.NEXT:BUTTON ""NEXT"" ""GOTO NextWrite"""
	WRITE #1 "POS 48. 26. 10. 1."
	WRITE #1 "WRITE.PREV:BUTTON ""PREV"" """""
	WRITE #1 "POS 48. 27. 10. 1."
	WRITE #1 "WRITE.CANCEL:BUTTON ""CANCEL"" """""
	WRITE #1 ""
	WRITE #1 "POS 35. 29. 25."
	WRITE #1 "TEXT ""go/BDCmodemVI for documentation"""
	CLOSE #1
	

	dialog.view &dialog_file

	
	;DIALOG.SET POINTER_ADDRESS.CRNT FORMAT.HEX(8,43c0000)
	DIALOG.DISABLE POINTER_ADDRESS.CRNT
	DIALOG.DISABLE POINTER_ADDRESS.HEAD
	DIALOG.DISABLE POINTER_ADDRESS.PREV
	
	DIALOG.DISABLE READ.NEXT 
	DIALOG.DISABLE READ.CANCEL 
	DIALOG.DISABLE READ.PREV
	STOP
	
	
NextWrite:
	&POINTER_ADDRESS_CRNT=DIALOG.STRING(POINTER_ADDRESS.NEXT)
	GOSUB MemWrite
	Dialog.end
	GOTO Write
	
MemWrite:
	&Start_0=DATA.LONG(D:&POINTER_ADDRESS_HEAD)
	PRINT &Start_0
	RETURN